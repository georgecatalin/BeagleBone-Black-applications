## Yocto-Project/meta-toggle_gpio60/conf/layer.conf
```bitbake
# We have a conf and classes directory, add to BBPATH
BBPATH .= ":${LAYERDIR}"

# We have recipes-* directories, add to BBFILES
BBFILES += "${LAYERDIR}/recipes-*/*/*.bb \
            ${LAYERDIR}/recipes-*/*/*.bbappend"

BBFILE_COLLECTIONS += "meta-toggle_gpio60"
BBFILE_PATTERN_meta-toggle_gpio60 = "^${LAYERDIR}/"
BBFILE_PRIORITY_meta-toggle_gpio60 = "6"

LAYERDEPENDS_meta-toggle_gpio60 = "core"
LAYERSERIES_COMPAT_meta-toggle_gpio60 = "dunfell"
```
